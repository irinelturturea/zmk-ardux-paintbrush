/*
 * Copyright (c) 2021 Mike "KemoNine" Crosson
 *
 * SPDX-License-Identifier: MIT
 */
// first by 2r2
#include <behaviors.dtsi>
#include <dt-bindings/zmk/keys.h>
#include <dt-bindings/zmk/bt.h>

// Left/Right
#define ARDUX_LEFT 1

// ARTS Row
#define KEY_A 3
#define KEY_R 2
#define KEY_T 1
#define KEY_S 0
// EYIO Row
#define KEY_E 7
#define KEY_Y 6
#define KEY_I 5
#define KEY_O 4

// Define Offsets
#define LEADING_NONES NONE(0,0,0)
#define MIDDLE_NONES NONE(0, 0, 0)
#define TRAILING_NONES NONE(0, 0, 0)

/*****************************************
 * ZMK Studio
 *
 * Every `the_paintbrush_left` target in .github/workflows/build.yml is built
 * with the `studio-rpc-usb-uart` snippet and `-DCONFIG_ZMK_STUDIO=y`, so this
 * keymap gets compiled with Studio support. Studio needs an `&studio_unlock`
 * binding somewhere in the keymap (the unlock is per session, and it is
 * enforced because ZMK Studio locking is on by default).
 *
 * ARDUX_LEFT's Custom layer has a free `&none` in its first position, so
 * override the layer here - ardux.dtsi only defines its own default if
 * ARDUX_LAYER_CUSTOM is not already defined - and use that spot for the
 * unlock.
 *
 * To unlock: hold the Custom layer key (the O position on the base layer) and
 * tap the first position (the S position). Remember that Studio overrides are
 * written to the settings partition and survive reboots AND reflashes - run
 * "Restore Stock Settings" in zmk.studio after flashing a new keymap.
 *****************************************/
#define ARDUX_LAYER_CUSTOM                                            \
		custom {                                                       \
			display-name = "Custom";                                          \
			bindings = <                                               \
				LEADING_NONES                                          \
				&studio_unlock      &kp C_VOL_UP  &kp INS   &kp C_MUTE \
				MIDDLE_NONES                                           \
				&mo LAYER_ID_CUSTOM &kp C_VOL_DN  &kp PSCRN &sk RSHFT  \
				TRAILING_NONES                                         \
		>;                                                             \
	};

// Include main ardux.io keymap
#include "../../../ardux.dtsi"

/*****************************************
 * Override: BT_CLR clears ALL profiles
 *
 * Upstream ardux.dtsi binds the global BT_CLR combo (R + Y + T + I) to
 * `&bt BT_CLR`, which only drops the bond of the ACTIVE profile - the other
 * five keep stale bonds and the keyboard stays invisible to a new host until
 * each profile is cleared one by one.
 *
 * `&bt BT_CLR_ALL` unpairs every profile and then auto-selects profile 0, so
 * one chord puts the keyboard back into a clean pairing state.
 *
 * Node is declared AFTER the ardux.dtsi include on purpose: devicetree merges
 * same-path nodes and the later property wins, so `bindings` here overrides
 * the upstream value while `key-positions` / `timeout-ms` stay as upstream.
 *****************************************/
/ {
    combos {
        combo_bt_clr {
            bindings = <&bt BT_CLR_ALL>;
        };
    };
};

